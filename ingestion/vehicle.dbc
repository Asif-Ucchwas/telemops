VERSION ""

NS_ :

BS_:

BU_: Vector__XXX

BO_ 256 VehicleStatus: 8 Vector__XXX
 SG_ VehicleSpeed : 0|8@1+ (1,0) [0|255] "km/h" Vector__XXX

BO_ 512 EngineStatus: 8 Vector__XXX
 SG_ EngineRPM : 0|16@1+ (1,0) [0|8000] "rpm" Vector__XXX
 SG_ BatteryTemp : 16|8@1+ (1,-40) [-40|120] "degC" Vector__XXX
